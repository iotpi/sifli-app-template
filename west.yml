## west.yml
```yaml
manifest:
  version: "1.2"
  remotes:
    - name: zephyrproject-rtos
      url-base: https://github.com/zephyrproject-rtos
    - name: iotpi
      url-base: https://github.com/iotpi

  defaults:
    remote: zephyrproject-rtos

  projects:
    - name: zephyr
      revision: v4.1.0
      clone-depth: 1
      import:
        name-allowlist:
          - cmsis
          - cmsis-dsp
          - cmsis-nn
          - picolibc
    - name: hal_sifli
      clone-depth: 1
      remote: iotpi
      revision: main
      path: modules/hal/sifli
    - name: sifli_zephyr
      clone-depth: 1
      remote: iotpi
      revision: main
      path: sifli_zephyr
  self:
    path: .
```
